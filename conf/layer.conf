## conf/layer.conf
```bitbake
# We have a conf and classes directory, add to BBPATH
BBPATH .= ":${LAYERDIR}"

# We have recipes-* directories, add to BBFILES
BBFILES += "${LAYERDIR}/recipes-*/*/*.bb \
            ${LAYERDIR}/recipes-*/*/*.bbappend"

BBFILE_COLLECTIONS += "meta-dctk-syns"
BBFILE_PATTERN_meta-dctk-syns = "^${LAYERDIR}/"
BBFILE_PRIORITY_meta-dctk-syns = "30"

LAYERDEPENDS_meta-dctk-syns = "core"
LAYERSERIES_COMPAT_meta-dctk-syns = "kirkstone"
SYNAREALMACH:sl1680_dct = "sl1680"

BBFILES_DYNAMIC += " \
    openembedded-layer:${LAYERDIR}/dynamic-layers/openembedded-layer/*/*/*.bbappend \
    \
    multimedia-layer:${LAYERDIR}/dynamic-layers/multimedia-layer/*/*/*.bbappend \
    \
    qt5-layer:${LAYERDIR}/dynamic-layers/qt5-layer/*/*/*.bbappend \
    \
    swupdate-layer:${LAYERDIR}/dynamic-layers/swupdate-layer/*/*/*.bbappend \
    \
    chromium-browser-layer:${LAYERDIR}/dynamic-layers/chromium-browser-layer/*/*/*.bbappend \
    \
    virtualization-layer:${LAYERDIR}/dynamic-layers/virtualization-layer/*/*/*.bbappend \
"
```

## conf/machine/sl1680_dct.conf
```bitbake
#@TYPE: Machine
#@NAME: sl1680_dct
#@DESCRIPTION: Machine configuration for the SL1680 SoC

require conf/machine/include/arm/armv8a/tune-cortexa73.inc

include conf/machine/include/syna.inc
include conf/machine/include/syna-sdk.inc

MACHINEOVERRIDES =. "dolphin:"

SYNA_SDK_CONFIG_NAME ?= "sl1680_${DISTRO_CONFIG}_aarch64_rdk"
SYNA_SDK_CONFIG_FILE ?= "${SYNA_SDK_CONFIG_NAME}_defconfig"
SYNA_KERNEL_CONFIG_FILE ?= "sl1680_dct_defconfig"
SYNA_KERNEL_DTS_FILE ?= "dct/sl1680-dct-rdk.dtb"
SYNA_KERNEL_DTBO_FILE ?= "dct/sl1680-dct-csi0-with-expander.dtbo \
                          dct/sl1680-dct-csi1-without-expander.dtbo \
                          dct/sl1680-dct-bothcsi-without-expander.dtbo \
                          dct/sl1680-dct-haier-panel-overlay.dtbo \
                          dct/sl1680-dct-ws-panel-overlay.dtbo \
                          dct/sl1680-dct-ws-1080p-panel-overlay.dtbo"

# WPE buffer size for media (important for youtube in 4K)
# 30MB for 1GB DRAM systems, 90MB for 2GB DRAM systems
SYNA_MEDIASOURCE_VIDEO_BUFFER_SIZE = "90"
# WPE RAM size limits, 192/200 for 1GB DRAM systems, 320/340 for 2GB DRAM systems
# (important to prevent memory pressure)
SYNA_WPE_RAM_SIZE = "320"
SYNA_WPE_WEB_PROCESS_RAM_SIZE = "340"

PREFERRED_VERSION_linux-syna:sl1680_dct = "5.15.140"
PREFERRED_VERSION_linux-firmware-syna:sl1680_dct = "5.15.140"

PREFERRED_PROVIDER_virtual/bootloader:sl1680_dct = "syna-u-boot"
PREFERRED_PROVIDER_virtual/kernel:sl1680_dct = "linux-dct"

PREFERRED_PROVIDER_u-boot-fw-utils:sl1680_dct= "libubootenv"
```
